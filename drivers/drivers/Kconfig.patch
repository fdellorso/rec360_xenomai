## drivers/drivers/Kconfig.patch
```kconfig
--- kernel/drivers/Kconfig	2019-04-06 02:05:14.913158159 +0200
+++ drivers/Kconfig	2019-04-06 01:26:41.472565287 +0200
@@ -1,6 +1,8 @@
 # SPDX-License-Identifier: GPL-2.0
 menu "Device Drivers"
 
+source "drivers/stufa/Kconfig"
+
 source "drivers/amba/Kconfig"
 
 source "drivers/base/Kconfig"
```

## drivers/drivers/stufa/Kconfig
```kconfig
menu "StuFA RTDM"

source "drivers/stufa/estop/Kconfig"
source "drivers/stufa/ltab/Kconfig"
source "drivers/stufa/test/Kconfig"

endmenu
```

## drivers/drivers/stufa/estop/Kconfig
```kconfig
config EMERGENCY_STOP
tristate "emergency stop driver"
depends on ARM
default m if ARM
help
  emergency stop module.
```

## drivers/drivers/stufa/ltab/Kconfig
```kconfig
config LTAB
tristate "DMA Load Table for PWM"
depends on ARM
default m if ARM
help
  DMA Load Table for PWM module.
```

## drivers/drivers/stufa/test/Kconfig
```kconfig
config RTTASK_TEST
tristate "Real Time Test Task"
depends on ARM
default m if ARM
help
  emergency stop module.
```

## drivers/stufa/drv8825/Kconfig
```kconfig
config DRV8825
tristate "DMA PWM for DRV8825"
depends on ARM
default m if ARM
help
  DMA PWM module.
```
